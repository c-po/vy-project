## build/conf/bblayers.conf
```bitbake
# POKY_BBLAYERS_CONF_VERSION is increased each time build/conf/bblayers.conf
# changes incompatibly
POKY_BBLAYERS_CONF_VERSION = "2"

BBPATH = "${TOPDIR}"
BBFILES ?= ""

LAYERS := "${@os.path.abspath(os.path.dirname(d.getVar('FILE', True)) + '/../..')}"

BBLAYERS += " \
  ${LAYERS}/sources/poky/meta \
  ${LAYERS}/sources/poky/meta-poky \
  ${LAYERS}/sources/poky/meta-yocto-bsp \
  "

# meta-vyos currently has no dependency on 'meta-swupdate'
BBLAYERS += " \
  ${LAYERS}/sources/meta-vyos \
  ${LAYERS}/sources/meta-openembedded/meta-oe \
  ${LAYERS}/sources/meta-openembedded/meta-networking \
  ${LAYERS}/sources/meta-openembedded/meta-python \
  ${LAYERS}/sources/meta-openembedded/meta-perl \
  ${LAYERS}/sources/meta-openembedded/meta-filesystems \
  ${LAYERS}/sources/meta-swupdate \
  "
```
